## config/boards/shields/rina_macro/Kconfig.defconfig
```kconfig
if SHIELD_RINA_MACRO

config ZMK_KEYBOARD_NAME
    default "rina_macro"

endif


CONFIG_ZMK_KEYBOARD_NAME="Rina Macro"
```

## config/boards/shields/rinamacro/Kconfig.defconfig
```kconfig
# Required files for ZMK to recognize the shield

if RINAMACRO

# Name must be less than 16 characters long!
config ZMK_KEYBOARD_NAME
    default "rinamacro"

endif
```
